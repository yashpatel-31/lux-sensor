&i2c0 {
	status = "okay";
	clock-frequency = <I2C_BITRATE_FAST>;
	vcnl4040@60 {
		status = "okay";
		compatible = "vishay,vcnl4040";
		reg = <0x60>;
		led-current = <200>;
		led-duty-cycle = <320>;
	};
};
